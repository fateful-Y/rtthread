## Kconfig
```kconfig
# Kconfig file for package ad7606
menuconfig PKG_USING_AD7606
    bool "AD7606: An ADC chip."
    default n

if PKG_USING_AD7606

    config PKG_AD7606_PATH
        string
        default "/packages/peripherals/ad7606"

    choice
        prompt "Version"
        default PKG_USING_AD7606_LATEST_VERSION
        help
            Select the package version

        config PKG_USING_AD7606_V100
            bool "v1.0.0"

        config PKG_USING_AD7606_LATEST_VERSION
            bool "latest"
    endchoice
          
    config PKG_AD7606_VER
       string
       default "v1.0.0"    if PKG_USING_AD7606_V100
       default "latest"    if PKG_USING_AD7606_LATEST_VERSION

endif
```
